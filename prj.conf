## CMakeLists.txt
```
#
# Copyright (c) 2022 Nordic Semiconductor ASA
#
# SPDX-License-Identifier: LicenseRef-Nordic-5-Clause
#

cmake_minimum_required(VERSION 3.20.0)

find_package(Zephyr REQUIRED HINTS $ENV{ZEPHYR_BASE})
if (NOT SYSBUILD)
	message(WARNING
		" This is multi-image application that should be build using sysbuild.\n"
		" Add --sysbuild argument to west build command to prepare all the images.")
endif()

project(GatewayFW_sysbuild)

# Example to add sources zephyr_include_directories(${CMAKE_CURRENT_SOURCE_DIR}/HAL)
zephyr_include_directories(${CMAKE_CURRENT_SOURCE_DIR}/src)

# Example to add sources FILE(GLOB app_sources HAL/*.c src/*.c)
FILE(GLOB app_sources src/*.c)

target_sources(app PRIVATE ${app_sources})
```

## Kconfig.sysbuild
```
#
# Copyright (c) 2023 Nordic Semiconductor ASA
#
# SPDX-License-Identifier: LicenseRef-Nordic-5-Clause
#

source "${ZEPHYR_BASE}/share/sysbuild/Kconfig"

config REMOTE_BOARD
	string "The board used for remote target"
	default "nrf5340dk_nrf5340_cpunet" if $(BOARD) = "nrf5340dk_nrf5340_cpuapp"
	default "nrf5340dk_nrf5340_cpunet" if $(BOARD) = "nrf5340dk_nrf5340_cpuapp_ns"
	default "UNKNOWN"
```

## prj.conf
```kconfig
CONFIG_LOG=y
CONFIG_LOG_MAX_LEVEL=4

CONFIG_BOARD_ENABLE_CPUNET=y

CONFIG_CLOCK_CONTROL_NRF_K32SRC_SYNTH=y
```

## src/main.c
```c
/*
 * Copyright (c) 2012-2014 Wind River Systems, Inc.
 *
 * SPDX-License-Identifier: Apache-2.0
 */

#include <stdio.h>
#include <zephyr/logging/log.h>
#include <zephyr/kernel.h>



LOG_MODULE_REGISTER(main_app, LOG_LEVEL_DBG);

int main(void)
{
	LOG_DBG("Hello World! %s\n", CONFIG_BOARD);

	while(1)
	{

		k_msleep(1000);
	}
	return 0;
}
```
